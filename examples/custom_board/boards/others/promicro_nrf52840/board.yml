## examples/custom_board/boards/others/promicro_nrf52840/board.yml
```yaml
board:
  name: custom_promicro_nrf52840
  full_name: Custom Pro Micro nRF52840
  vendor: others
  socs:
    - name: nrf52840
      variants:
        - name: uf2
```
