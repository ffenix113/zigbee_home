## CMakeLists.txt
```
#
# Copyright (c) 2022 Nordic Semiconductor ASA
#
# SPDX-License-Identifier: LicenseRef-Nordic-5-Clause
#

cmake_minimum_required(VERSION 3.20.0)

################################################################################

# The application uses the configuration/<board> scheme for configuration files.
set(APPLICATION_CONFIG_DIR "${CMAKE_CURRENT_SOURCE_DIR}")

find_package(Zephyr REQUIRED HINTS $ENV{ZEPHYR_BASE})
project(zigbee_common)

################################################################################

# NORDIC SDK APP START
FILE(GLOB app_sources src/*.c)
target_sources(app PRIVATE ${app_sources})

# NORDIC SDK APP END
```

## prj.conf
```kconfig
#
# Copyright (c) 2022 Nordic Semiconductor ASA
#
# SPDX-License-Identifier: LicenseRef-Nordic-5-Clause
#

# Debug configuration


# Logging
CONFIG_LOG=y
CONFIG_SERIAL=y
CONFIG_CONSOLE=y
CONFIG_UART_CONSOLE=y
CONFIG_UART_LINE_CTRL=y
#CONFIG_ZIGBEE_WEATHER_STATION_LOG_LEVEL_INF=y

# USB
CONFIG_USB_DEVICE_INITIALIZE_AT_BOOT=n
CONFIG_USB_DEVICE_PRODUCT="Dongle: Zigbee Weather Station"
CONFIG_USB_DEVICE_PID=0x0004
#CONFIG_USB_CDC_ACM_LOG_LEVEL_OFF=y
CONFIG_USB_DEVICE_STACK=y
# CONFIG_USB_CDC_ACM=y

# Sensors
CONFIG_I2C=y
CONFIG_SENSOR=y
CONFIG_BME680=y

# Development Kit LED and Buttons library
CONFIG_DK_LIBRARY=y

# Zigbee
CONFIG_ZIGBEE=y
CONFIG_ZIGBEE_APP_UTILS=y
CONFIG_ZIGBEE_ROLE_END_DEVICE=y

# Enable crypto for zigbee
CONFIG_CRYPTO=y
CONFIG_CRYPTO_NRF_ECB=y
CONFIG_CRYPTO_INIT_PRIORITY=80

# Use software cryptography on nRF5340
# CONFIG_ZIGBEE_USE_SOFTWARE_AES=n

# Enable API for powering down unused RAM parts
CONFIG_RAM_POWER_DOWN_LIBRARY=y

# Networking
CONFIG_NET_IPV6=n
CONFIG_NET_IP_ADDR_CHECK=n
CONFIG_NET_UDP=n

# Troubleshooting
CONFIG_ZBOSS_HALT_ON_ASSERT=y
CONFIG_RESET_ON_FATAL_ERROR=n

# CONFIG_LOG_BACKEND_UART=y
# This example requires more workqueue stack
CONFIG_SYSTEM_WORKQUEUE_STACK_SIZE=2048
#CONFIG_HEAP_MEM_POOL_SIZE=2048
#CONFIG_MAIN_THREAD_PRIORITY=7
#CONFIG_DEBUG_OPTIMIZATIONS=n
#CONFIG_DEBUG_THREAD_INFO=n

# CONFIG_ZIGBEE_UART_SUPPORTS_FLOW_CONTROL=y
# CONFIG_ZIGBEE_HAVE_SERIAL=y
# CONFIG_ZIGBEE_HAVE_ASYNC_SERIAL=y
# CONFIG_ZIGBEE_UART_RX_BUF_LEN=256
# CONFIG_ZIGBEE_UART_TX_TIMEOUT=1000
# CONFIG_ZIGBEE_UART_RX_TIMEOUT=1000
# CONFIG_NCS_SAMPLES_DEFAULTS=y
```

## src/main.c
```c
/*
 * Copyright (c) 2022 Nordic Semiconductor ASA
 *
 * SPDX-License-Identifier: LicenseRef-Nordic-5-Clause
 */

#include <zephyr/device.h>
#include <dk_buttons_and_leds.h>
#include <zephyr/drivers/uart.h>
#include <zephyr/logging/log.h>
#include <ram_pwrdn.h>
#include <zb_nrf_platform.h>
#include <zboss_api.h>
#include <zboss_api_addons.h>
#include <zephyr/kernel.h>
#include <zigbee/zigbee_app_utils.h>
#include <zigbee/zigbee_error_handler.h>

#ifdef CONFIG_USB_DEVICE_STACK
#include <zephyr/usb/usb_device.h>
#include <zephyr/usb/usbd.h>
#include <zephyr/sys/printk.h>
#endif /* CONFIG_USB_DEVICE_STACK */

#include "weather_station.h"

/* Delay for console initialization */
#define WAIT_FOR_CONSOLE_MSEC 100
#define WAIT_FOR_CONSOLE_DEADLINE_MSEC 2000

/* Weather check period */
#define WEATHER_CHECK_PERIOD_MSEC (1000 * CONFIG_WEATHER_CHECK_PERIOD_SECONDS)

/* Delay for first weather check */
#define WEATHER_CHECK_INITIAL_DELAY_MSEC (1000 * CONFIG_FIRST_WEATHER_CHECK_DELAY_SECONDS)

/* Time of LED on state while blinking for identify mode */
#define IDENTIFY_LED_BLINK_TIME_MSEC 500

/* In Thingy53 each LED is a RGB component of a single LED */
#define LED_RED DK_LED1
#define LED_GREEN DK_LED2
#define LED_BLUE DK_LED3

/* LED indicating that device successfully joined Zigbee network */
#define ZIGBEE_NETWORK_STATE_LED LED_BLUE

/* LED used for device identification */
#define IDENTIFY_LED LED_RED

/* Button used to enter the Identify mode */
#define IDENTIFY_MODE_BUTTON DK_BTN1_MSK

/* Button to start Factory Reset */
#define FACTORY_RESET_BUTTON IDENTIFY_MODE_BUTTON

BUILD_ASSERT(DT_NODE_HAS_COMPAT(DT_CHOSEN(zephyr_console),
				zephyr_cdc_acm_uart),
	     "Console device is not ACM CDC UART device");
LOG_MODULE_REGISTER(app, LOG_LEVEL_INF);// CONFIG_ZIGBEE_WEATHER_STATION_LOG_LEVEL);

/* Stores all cluster-related attributes */
static struct zb_device_ctx dev_ctx;

/* Attributes setup */
ZB_ZCL_DECLARE_BASIC_ATTRIB_LIST(
	basic_attr_list,
	&dev_ctx.basic_attr.zcl_version, &dev_ctx.basic_attr.power_source);

/* Declare attribute list for Identify cluster (client). */
ZB_ZCL_DECLARE_IDENTIFY_CLIENT_ATTRIB_LIST(
	identify_client_attr_list);

/* Declare attribute list for Identify cluster (server). */
ZB_ZCL_DECLARE_IDENTIFY_SERVER_ATTRIB_LIST(
	identify_server_attr_list,
	&dev_ctx.identify_attr.identify_time);

ZB_ZCL_DECLARE_TEMP_MEASUREMENT_ATTRIB_LIST(
	temperature_measurement_attr_list,
	&dev_ctx.temp_attrs.measure_value,
	&dev_ctx.temp_attrs.min_measure_value,
	&dev_ctx.temp_attrs.max_measure_value,
	&dev_ctx.temp_attrs.tolerance
	);

ZB_ZCL_DECLARE_PRESSURE_MEASUREMENT_ATTRIB_LIST(
	pressure_measurement_attr_list,
	&dev_ctx.pres_attrs.measure_value,
	&dev_ctx.pres_attrs.min_measure_value,
	&dev_ctx.pres_attrs.max_measure_value,
	&dev_ctx.pres_attrs.tolerance
	);

ZB_ZCL_DECLARE_REL_HUMIDITY_MEASUREMENT_ATTRIB_LIST(
	humidity_measurement_attr_list,
	&dev_ctx.humidity_attrs.measure_value,
	&dev_ctx.humidity_attrs.min_measure_value,
	&dev_ctx.humidity_attrs.max_measure_value
	);

/* Clusters setup */
ZB_HA_DECLARE_WEATHER_STATION_CLUSTER_LIST(
	weather_station_cluster_list,
	basic_attr_list,
	identify_client_attr_list,
	identify_server_attr_list,
	temperature_measurement_attr_list,
	pressure_measurement_attr_list,
	humidity_measurement_attr_list);

/* Endpoint setup (single) */
ZB_HA_DECLARE_WEATHER_STATION_EP(
	weather_station_ep,
	WEATHER_STATION_ENDPOINT_NB,
	weather_station_cluster_list);

/* Device context */
ZBOSS_DECLARE_DEVICE_CTX_1_EP(
	weather_station_ctx,
	weather_station_ep);


static void mandatory_clusters_attr_init(void)
{
	/* Basic cluster attributes */
	dev_ctx.basic_attr.zcl_version = ZB_ZCL_VERSION;
	dev_ctx.basic_attr.power_source = ZB_ZCL_BASIC_POWER_SOURCE_BATTERY;

	/* Identify cluster attributes */
	dev_ctx.identify_attr.identify_time = ZB_ZCL_IDENTIFY_IDENTIFY_TIME_DEFAULT_VALUE;
}

static void measurements_clusters_attr_init(void)
{
	/* Temperature */
	dev_ctx.temp_attrs.measure_value = ZB_ZCL_ATTR_TEMP_MEASUREMENT_VALUE_UNKNOWN;
	dev_ctx.temp_attrs.min_measure_value = WEATHER_STATION_ATTR_TEMP_MIN;
	dev_ctx.temp_attrs.max_measure_value = WEATHER_STATION_ATTR_TEMP_MAX;
	dev_ctx.temp_attrs.tolerance = WEATHER_STATION_ATTR_TEMP_TOLERANCE;

	/* Pressure */
	dev_ctx.pres_attrs.measure_value = ZB_ZCL_ATTR_PRESSURE_MEASUREMENT_VALUE_UNKNOWN;
	dev_ctx.pres_attrs.min_measure_value = WEATHER_STATION_ATTR_PRESSURE_MIN;
	dev_ctx.pres_attrs.max_measure_value = WEATHER_STATION_ATTR_PRESSURE_MAX;
	dev_ctx.pres_attrs.tolerance = WEATHER_STATION_ATTR_PRESSURE_TOLERANCE;

	/* Humidity */
	dev_ctx.humidity_attrs.measure_value = ZB_ZCL_ATTR_REL_HUMIDITY_MEASUREMENT_VALUE_UNKNOWN;
	dev_ctx.humidity_attrs.min_measure_value = WEATHER_STATION_ATTR_HUMIDITY_MIN;
	dev_ctx.humidity_attrs.max_measure_value = WEATHER_STATION_ATTR_HUMIDITY_MAX;
	/* Humidity measurements tolerance is not supported at the moment */
}

static void toggle_identify_led(zb_bufid_t bufid)
{
	static bool led_on;

	led_on = !led_on;
	dk_set_led(IDENTIFY_LED, led_on);
	zb_ret_t err = ZB_SCHEDULE_APP_ALARM(toggle_identify_led,
					     bufid,
					     ZB_MILLISECONDS_TO_BEACON_INTERVAL(
						     IDENTIFY_LED_BLINK_TIME_MSEC));
	if (err) {
		LOG_ERR("Failed to schedule app alarm: %d", err);
	}
}

static void start_identifying(zb_bufid_t bufid)
{
	ZVUNUSED(bufid);

	if (ZB_JOINED()) {
		/*
		 * Check if endpoint is in identifying mode,
		 * if not put desired endpoint in identifying mode.
		 */
		if (dev_ctx.identify_attr.identify_time ==
		    ZB_ZCL_IDENTIFY_IDENTIFY_TIME_DEFAULT_VALUE) {

			zb_ret_t zb_err_code = zb_bdb_finding_binding_target(
				WEATHER_STATION_ENDPOINT_NB);

			if (zb_err_code == RET_OK) {
				LOG_INF("Manually enter identify mode");
			} else if (zb_err_code == RET_INVALID_STATE) {
				LOG_WRN("RET_INVALID_STATE - Cannot enter identify mode");
			} else {
				ZB_ERROR_CHECK(zb_err_code);
			}
		} else {
			LOG_INF("Manually cancel identify mode");
			zb_bdb_finding_binding_target_cancel();
		}
	} else {
		LOG_WRN("Device not in a network - cannot identify itself");
	}
}

static void identify_callback(zb_bufid_t bufid)
{
	zb_ret_t err = RET_OK;

	if (bufid) {
		/* Schedule a self-scheduling function that will toggle the LED */
		err = ZB_SCHEDULE_APP_CALLBACK(toggle_identify_led, bufid);
		if (err) {
			LOG_ERR("Failed to schedule app callback: %d", err);
		} else {
			LOG_INF("Enter identify mode");
		}
	} else {
		/* Cancel the toggling function alarm and turn off LED */
		err = ZB_SCHEDULE_APP_ALARM_CANCEL(toggle_identify_led,
						   ZB_ALARM_ANY_PARAM);
		if (err) {
			LOG_ERR("Failed to schedule app alarm cancel: %d", err);
		} else {
			dk_set_led_off(IDENTIFY_LED);
			LOG_INF("Cancel identify mode");
		}
	}
}

static void button_changed(uint32_t button_state, uint32_t has_changed)
{
	if (IDENTIFY_MODE_BUTTON & has_changed) {
		if (IDENTIFY_MODE_BUTTON & button_state) {
			/* Button changed its state to pressed */
		} else {
			/* Button changed its state to released */
			if (was_factory_reset_done()) {
				/* The long press was for Factory Reset */
				LOG_DBG("After Factory Reset - ignore button release");
			} else   {
				/* Button released before Factory Reset */

				/* Start identification mode */
				zb_ret_t err = ZB_SCHEDULE_APP_CALLBACK(start_identifying, 0);

				if (err) {
					LOG_ERR("Failed to schedule app callback: %d", err);
				}

				/* Inform default signal handler about user input at the device */
				user_input_indicate();
			}
		}
	}

	check_factory_reset_button(button_state, has_changed);
}

static void gpio_init(void)
{
	int err = dk_buttons_init(button_changed);

	if (err) {
		LOG_ERR("Cannot init buttons (err: %d)", err);
	}

	err = dk_leds_init();
	if (err) {
		LOG_ERR("Cannot init LEDs (err: %d)", err);
	}
}

#ifdef CONFIG_USB_DEVICE_STACK
static void wait_for_console(void)
{
	const struct device *console = DEVICE_DT_GET(DT_CHOSEN(zephyr_console));
	uint32_t dtr = 0;
	uint32_t time = 0;

	/* Enable the USB subsystem and associated HW */
	if (usb_enable(NULL)) {
		LOG_ERR("Failed to enable USB");
	} else {
		/* Wait for DTR flag or deadline (e.g. when USB is not connected) */
		// while (!dtr && time < WAIT_FOR_CONSOLE_DEADLINE_MSEC) {
		// 	uart_line_ctrl_get(console, UART_LINE_CTRL_DTR, &dtr);
		// 	/* Give CPU resources to low priority threads */
		// 	k_sleep(K_MSEC(WAIT_FOR_CONSOLE_MSEC));
		// 	time += WAIT_FOR_CONSOLE_MSEC;
		// }
		while (!dtr) {
			uart_line_ctrl_get(console, UART_LINE_CTRL_DTR, &dtr);
			/* Give CPU resources to low priority threads. */
			k_sleep(K_MSEC(500));
		}
	}
}
#endif /* CONFIG_USB_DEVICE_STACK */

static void check_weather(zb_bufid_t bufid)
{
	ZVUNUSED(bufid);

	int err = weather_station_check_weather();

	if (err) {
		LOG_ERR("Failed to check weather: %d", err);
	} else {
		err = weather_station_update_temperature();
		if (err) {
			LOG_ERR("Failed to update temperature: %d", err);
		}

		err = weather_station_update_pressure();
		if (err) {
			LOG_ERR("Failed to update pressure: %d", err);
		}

		err = weather_station_update_humidity();
		if (err) {
			LOG_ERR("Failed to update humidity: %d", err);
		}
	}

	zb_ret_t zb_err = ZB_SCHEDULE_APP_ALARM(check_weather,
						0,
						ZB_MILLISECONDS_TO_BEACON_INTERVAL(
							WEATHER_CHECK_PERIOD_MSEC));
	if (zb_err) {
		LOG_ERR("Failed to schedule app alarm: %d", zb_err);
	}
}

void log_data() {
	int err = weather_station_check_weather();

	if (err) {
		LOG_ERR("Failed to check weather: %d", err);
	} else {
		float measured_temperature = 0.0f;
		int16_t temperature_attribute = 0;

		err = sensor_get_temperature(&measured_temperature);
		if (err) {
			LOG_ERR("Failed to get sensor temperature: %d", err);
		} else {
			/* Convert measured value to attribute value, as specified in ZCL */
			temperature_attribute = (int16_t)
						(measured_temperature *
						ZCL_TEMPERATURE_MEASUREMENT_MEASURED_VALUE_MULTIPLIER);
			LOG_INF("Attribute T:%10d", temperature_attribute);
		}
	}
}

void zboss_signal_handler(zb_bufid_t bufid)
{
	zb_zdo_app_signal_hdr_t *signal_header = NULL;
	zb_zdo_app_signal_type_t signal = zb_get_app_signal(bufid, &signal_header);
	zb_ret_t err = RET_OK;

	/* Update network status LED but only for debug configuration */
	#ifdef CONFIG_LOG
	zigbee_led_status_update(bufid, ZIGBEE_NETWORK_STATE_LED);
	#endif /* CONFIG_LOG */

	/* Detect ZBOSS startup */
	switch (signal) {
	case ZB_ZDO_SIGNAL_SKIP_STARTUP:
		/* ZBOSS framework has started - schedule first weather check */
		err = ZB_SCHEDULE_APP_ALARM(check_weather,
					    0,
					    ZB_MILLISECONDS_TO_BEACON_INTERVAL(
						    WEATHER_CHECK_INITIAL_DELAY_MSEC));
		if (err) {
			LOG_ERR("Failed to schedule app alarm: %d", err);
		}
		break;
	default:
		break;
	}

	/* Let default signal handler process the signal*/
	ZB_ERROR_CHECK(zigbee_default_signal_handler(bufid));

	/*
	 * All callbacks should either reuse or free passed buffers.
	 * If bufid == 0, the buffer is invalid (not passed).
	 */
	if (bufid) {
		zb_buf_free(bufid);
	}
}

int main(void)
{
	#ifdef CONFIG_USB_DEVICE_STACK
	wait_for_console();
	#endif /* CONFIG_USB_DEVICE_STACK */

	LOG_INF("App init");

	register_factory_reset_button(FACTORY_RESET_BUTTON);
	gpio_init();
	weather_station_init();

	/* Register device context (endpoint) */
	ZB_AF_REGISTER_DEVICE_CTX(&weather_station_ctx);

	/* Init Basic and Identify attributes */
	mandatory_clusters_attr_init();

	/* Init measurements-related attributes */
	measurements_clusters_attr_init();

	/* Register callback to identify notifications */
	ZB_AF_SET_IDENTIFY_NOTIFICATION_HANDLER(WEATHER_STATION_ENDPOINT_NB, identify_callback);

	/* Enable Sleepy End Device behavior */
	zb_set_rx_on_when_idle(ZB_FALSE);
	if (IS_ENABLED(CONFIG_RAM_POWER_DOWN_LIBRARY)) {
		power_down_unused_ram();
	}

	/* Start Zigbee stack */
	zb_set_bdb_primary_channel_set(11);
	zigbee_enable();

	dk_set_led_on(LED_RED);

	LOG_INF("app started");

	// while (1) {
	// 	k_sleep(K_SECONDS(5));
	// 	dk_set_led_on(LED_BLUE);
	// 	// k_sleep(K_SECONDS(1));
	// 	// log_data();
	// 	dk_set_led_off(LED_BLUE);
	// 	// LOG_INF("weather checked");
	// }

	return 0;
}
```

## src/sensor.c
```c
/*
 * Copyright (c) 2022 Nordic Semiconductor ASA
 *
 * SPDX-License-Identifier: LicenseRef-Nordic-5-Clause
 */

#include <zephyr/logging/log.h>

#include "sensor.h"

/*
 * Sensor value is represented as having an integer and a fractional part,
 * and can be obtained using the formula val1 + val2 * 10^(-6).
 */
#define SENSOR_VAL2_DIVISOR 1000000

LOG_MODULE_DECLARE(app, CONFIG_ZIGBEE_WEATHER_STATION_LOG_LEVEL);

static const struct device *sensor;

/*
 * Sensor value is represented as having an integer and a fractional part,
 * and can be obtained using the formula val1 + val2 * 10^(-6). Negative
 * values also adhere to the above formula, but may need special attention.
 * Here are some examples of the value representation:
 *
 *      0.5: val1 =  0, val2 =  500000
 *     -0.5: val1 =  0, val2 = -500000
 *     -1.0: val1 = -1, val2 =  0
 *     -1.5: val1 = -1, val2 = -500000
 */
static float convert_sensor_value(struct sensor_value value)
{
	float result = 0.0f;

	/* Determine sign */
	result = (value.val1 < 0 || value.val2 < 0) ? -1.0f : 1.0f;

	/* Use absolute values */
	value.val1 = value.val1 < 0 ? -value.val1 : value.val1;
	value.val2 = value.val2 < 0 ? -value.val2 : value.val2;

	/* Calculate value */
	result *= (value.val1 + value.val2 / (float)SENSOR_VAL2_DIVISOR);

	return result;
}

int sensor_init(void)
{
	int err = 0;

	if (sensor) {
		LOG_WRN("Sensor already initialized");
	} else {
		sensor = DEVICE_DT_GET(DT_INST(0, bosch_bme280));
		if (!sensor) {
			LOG_ERR("Failed to get device");
			err = ENODEV;
		}
	}

	return err;
}

int sensor_update_measurements(void)
{
	int err = 0;

	if (sensor) {
		err = sensor_sample_fetch(sensor);
	} else {
		LOG_ERR("Sensor not initialized");
		err = ENODEV;
	}

	return err;
}

int sensor_get_temperature(float *temperature)
{
	int err = 0;

	if (temperature) {
		if (sensor) {
			struct sensor_value sensor_temperature;

			err = sensor_channel_get(sensor,
						 SENSOR_CHAN_AMBIENT_TEMP,
						 &sensor_temperature);
			if (err) {
				LOG_ERR("Failed to get sensor channel: %d", err);
			} else {
				LOG_INF("Sensor    T:%3d.%06d [*C]",
					sensor_temperature.val1, sensor_temperature.val2);
				*temperature = convert_sensor_value(sensor_temperature);
			}
		} else {
			LOG_ERR("Sensor not initialized");
			err = ENODEV;
		}
	} else {
		LOG_ERR("NULL param");
		err = EINVAL;
	}

	return err;
}

int sensor_get_pressure(float *pressure)
{
	int err = 0;

	if (pressure) {
		if (sensor) {
			struct sensor_value sensor_pressure;

			err = sensor_channel_get(sensor,
						 SENSOR_CHAN_PRESS,
						 &sensor_pressure);
			if (err) {
				LOG_ERR("Failed to get sensor channel: %d", err);
			} else {
				LOG_INF("Sensor    P:%3d.%06d [kPa]",
					sensor_pressure.val1, sensor_pressure.val2);
				*pressure = convert_sensor_value(sensor_pressure);
			}
		} else {
			LOG_ERR("Sensor not initialized");
			err = ENODEV;
		}
	} else {
		LOG_ERR("NULL param");
		err = EINVAL;
	}

	return err;
}

int sensor_get_humidity(float *humidity)
{
	int err = 0;

	if (humidity) {
		if (sensor) {
			struct sensor_value sensor_humidity;

			err = sensor_channel_get(sensor,
						 SENSOR_CHAN_HUMIDITY,
						 &sensor_humidity);
			if (err) {
				LOG_ERR("Failed to get sensor channel: %d", err);
			} else {
				LOG_INF("Sensor    H:%3d.%06d [%%]",
					sensor_humidity.val1, sensor_humidity.val2);
				*humidity = convert_sensor_value(sensor_humidity);
			}
		} else {
			LOG_ERR("Sensor not initialized");
			err = ENODEV;
		}
	} else {
		LOG_ERR("NULL param");
		err = EINVAL;
	}

	return err;
}
```
